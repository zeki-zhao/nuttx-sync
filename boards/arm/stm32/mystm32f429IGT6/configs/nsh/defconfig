## drivers/LEDBling/Kconfig
```kconfig
menu "LEDBling"
 
config MY_LED_BLING
        bool "MY_LED_BLING device support"
        default n
        ---help---
                Enable driver support for the Led Bling controler.
endmenu # LEDBling
```

## drivers/myled/Kconfig
```kconfig
config MY_LED
	bool "my RGB led device support"
	default n
	---help---
		Enable driver support for the my LED controler.
```

## drivers/simulative_i2c/Kconfig
```kconfig
config MY_TOUCH
	bool "my touch device support"
	default n
	---help---
		Enable driver support for the my touch.
```
